## mt6797/Kconfig
```kconfig
#
# FPC sensors
#

config INPUT_FPC1020_IRQ
	tristate "FPC fingerprint sensor IRQ support"
	help
		If you say yes here you get IRQ support for fingerprint
		sensors from Fingerprint Cards (FPC).
```
